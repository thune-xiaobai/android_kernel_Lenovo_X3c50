/* Copyright (c) 2013, The Linux Foundation. All rights reserved.
 *
 * This program is free software; you can redistribute it and/or modify
 * it under the terms of the GNU General Public License version 2 and
 * only version 2 as published by the Free Software Foundation.
 *
 * This program is distributed in the hope that it will be useful,
 * but WITHOUT ANY WARRANTY; without even the implied warranty of
 * MERCHANTABILITY or FITNESS FOR A PARTICULAR PURPOSE.  See the
 * GNU General Public License for more details.
 */

/*---------------------------------------------------------------------------
 * This file is autogenerated file using gcdb parser. Please do not edit it.
 * Update input XML file to add a new entry or update variable in this file
 * VERSION = "1.0"
 *---------------------------------------------------------------------------*/
&mdss_mdp {
	dsi_otm1906c_1080p_cmd: qcom,mdss_dsi_otm1906c_1080p_cmd {
		qcom,mdss-dsi-panel-name = "otm1906c 1080p command mode dsi panel";
		qcom,mdss-dsi-panel-controller = <&mdss_dsi0>;
		qcom,mdss-dsi-panel-type = "dsi_cmd_mode";
		qcom,mdss-dsi-panel-destination = "display_1";
		qcom,mdss-dsi-panel-framerate = <60>;
		qcom,mdss-dsi-virtual-channel-id = <0>;
		qcom,mdss-dsi-stream = <0>;
		qcom,mdss-dsi-panel-width = <1080>;
		qcom,mdss-dsi-panel-height = <1920>;
		qcom,mdss-dsi-h-front-porch = <90>;
		qcom,mdss-dsi-h-back-porch = <90>;
		qcom,mdss-dsi-h-pulse-width = <1>;
		qcom,mdss-dsi-h-sync-skew = <0>;
		qcom,mdss-dsi-v-back-porch = <18>;
		qcom,mdss-dsi-v-front-porch = <20>;
		qcom,mdss-dsi-v-pulse-width = <2>;
		qcom,mdss-dsi-h-left-border = <0>;
		qcom,mdss-dsi-h-right-border = <0>;
		qcom,mdss-dsi-v-top-border = <0>;
		qcom,mdss-dsi-v-bottom-border = <0>;
		qcom,mdss-dsi-bpp = <24>;
		qcom,mdss-dsi-color-order = "rgb_swap_rgb";
		qcom,mdss-dsi-underflow-color = <0xff>;
		qcom,mdss-dsi-border-color = <0>;
//		qcom,mdss-dsi-pixel-packing = "tight";
		qcom,mdss-dsi-pixel-alignment = <0>;
		qcom,mdss-dsi-on-command = [23 00 00 00 00 00 02 00 00
                    29 00 00 00 00 00 04 FF 19 06 01
                    23 00 00 00 00 00 02 00 80
                    29 00 00 00 00 00 03 FF 19 06
                    23 00 00 00 00 00 02 00 90
                    23 00 00 00 00 00 02 b0 00
                    23 00 00 00 00 00 02 00 A0
                    29 00 00 00 00 00 04 C1 00 c0 10
                    23 00 00 00 00 00 02 00 82
                    23 00 00 00 00 00 02 D6 12
                    23 00 00 00 00 00 02 00 91
                    29 00 00 00 00 00 03 c5 14 1E
                    23 00 00 00 00 00 02 00 95
                    23 00 00 00 00 00 02 c5 11
//                    23 00 00 00 00 00 02 00 07
//                    23 00 00 00 00 00 02 D9 CD
//            23 00 00 00 00 00 02 00 90
//            29 00 00 00 00 00 02 D6 60
//            23 00 00 00 00 00 02 00 82
//            23 00 00 00 00 00 02 c6 02
                    23 00 00 00 00 00 02 00 81
                    23 00 00 00 00 00 02 a5 05
                    23 00 00 00 00 00 02 00 a5
                    23 00 00 00 00 00 02 c5 11
                    23 00 00 00 00 00 02 00 90
                    29 00 00 00 00 00 05 f5 09 16 09 16
                    23 00 00 00 00 00 02 00 a7
                    23 00 00 00 00 00 02 f5 1A
                    23 00 00 00 00 00 02 00 9d
                    23 00 00 00 00 00 02 f5 1a
                    23 00 00 00 00 00 02 00 a5
                    23 00 00 00 00 00 02 f5 16
                    23 00 00 00 00 00 02 00 8d
                    23 00 00 00 00 00 02 f5 17
                    23 00 00 00 00 00 02 00 e3
                    23 00 00 00 00 00 02 f5 11
                    23 00 00 00 00 00 02 00 ed
                    23 00 00 00 00 00 02 f5 00
                    23 00 00 00 00 00 02 00 e5
                    23 00 00 00 00 00 02 f5 00
                    23 00 00 00 00 00 02 00 81
                    23 00 00 00 00 00 02 f5 16
                    23 00 00 00 00 00 02 00 83
                    23 00 00 00 00 00 02 f5 16
                    23 00 00 00 00 00 02 00 e1
                    23 00 00 00 00 00 02 f5 16
                    23 00 00 00 00 00 02 00 c0
                    29 00 00 00 00 00 10 cc 00 00 00 00 00 00 00 00 00 00 00 00 00 00 00
                    23 00 00 00 00 00 02 00 d0
                    29 00 00 00 00 00 10 cc 00 00 00 00 00 00 00 00 00 00 00 00 00 00 00
                    23 00 00 00 00 00 02 00 e0
                    29 00 00 00 00 00 10 cc 00 00 00 00 00 00 00 00 00 00 00 00 00 00 00
                    23 00 00 00 00 00 02 00 80
                    29 00 00 00 00 00 03 c1 55 55
                    23 00 00 00 00 00 02 00 94
                    23 00 00 00 00 00 02 c5 67
                    23 00 00 00 00 00 02 00 a4
                    23 00 00 00 00 00 02 c5 67
                    23 00 00 00 00 00 02 00 c1
                    23 00 00 00 00 00 02 c5 75
                    23 00 00 00 00 00 02 00 b3
                    23 00 00 00 00 00 02 c0 88
                    23 00 00 00 00 00 02 00 00
                    29 00 00 00 00 00 03 d8 23 23
                    23 00 00 00 00 00 02 00 80
                    23 00 00 00 00 00 02 c4 61
                    23 00 00 00 00 00 02 00 a0
                    23 00 00 00 00 00 02 b3 33
                    23 00 00 00 00 00 02 00 a6
                    23 00 00 00 00 00 02 b3 30
                    23 00 00 00 00 00 02 00 e0
                    29 00 00 00 00 00 0b b4 1C 19 3F 01 64 5C 01 A0 5F A0
                    23 00 00 00 00 00 02 00 f0
                    23 00 00 00 00 00 02 b4 64
                    23 00 00 00 00 00 02 00 80
                    29 00 00 00 00 00 0f c0 00 71 00 0a 0a 00 71 0a 0a 00 71 00 0a 0a
                    23 00 00 00 00 00 02 00 90
                    29 00 00 00 00 00 07 c0 00 00 00 02 00 04
                    23 00 00 00 00 00 02 00 a0
                    29 00 00 00 00 00 10 c0 00 00 02 00 04 15 04 33 00 33 00 33 00 33 00
                    23 00 00 00 00 00 02 00 d0
                    29 00 00 00 00 00 10 c0 00 00 02 00 04 15 04 33 00 33 00 33 00 33 00
                    23 00 00 00 00 00 02 00 80
                    29 00 00 00 00 00 0d c2 83 01 00 00 82 01 00 00 00 00 00 00
                    23 00 00 00 00 00 02 00 90
                    29 00 00 00 00 00 0d c2 00 00 00 00 00 00 00 00 00 00 00 00
                    23 00 00 00 00 00 02 00 a0
                    29 00 00 00 00 00 0e c2 00 00 00 00 00 00 00 00 00 00 00 00 00
                    23 00 00 00 00 00 02 00 b0
                    29 00 00 00 00 00 10 c2 82 02 00 00 88 81 02 00 00 88 00 02 00 00 88
                    23 00 00 00 00 00 02 00 c0
                    29 00 00 00 00 00 10 c2 01 02 00 00 88 00 00 00 00 00 00 00 00 00 00
                    23 00 00 00 00 00 02 00 d0
                    29 00 00 00 00 00 10 c2 00 00 00 00 00 00 00 00 00 00 33 33 33 33 00
                    23 00 00 00 00 00 02 00 80
                    29 00 00 00 00 00 10 c3 00 00 00 00 00 00 00 00 00 00 00 00 00 00 00
                    23 00 00 00 00 00 02 00 a0
                    29 00 00 00 00 00 0D c3 83 01 00 00 82 01 00 00 00 00 00 00
                    23 00 00 00 00 00 02 00 b0
                    29 00 00 00 00 00 0f c3 00 00 00 00 82 02 00 00 88 81 02 00 00 88
                    23 00 00 00 00 00 02 00 c0 
                    29 00 00 00 00 00 10 c3 00 02 00 00 88 01 02 00 00 88 00 00 00 00 00
                    23 00 00 00 00 00 02 00 d0
                    29 00 00 00 00 00 10 c3 00 00 00 00 00 00 00 00 00 00 00 00 00 00 00
                    23 00 00 00 00 00 02 00 e0
                    29 00 00 00 00 00 06 c3 33 33 33 33 00
                    23 00 00 00 00 00 02 00 b0
                    23 00 00 00 00 00 02 ca 43 
                    23 00 00 00 00 00 02 00 b2
                    23 00 00 00 00 00 02 ca 5f
					23 00 00 00 00 00 02 00 80
                    29 00 00 00 00 00 0c cb 00 00 00 00 30 00 03 00 00 00 70
                    23 00 00 00 00 00 02 00 90
                    29 00 00 00 00 00 10 cb 00 00 00 00 00 00 00 00 00 00 00 00 00 00 00
                    23 00 00 00 00 00 02 00 a0
                    29 00 00 00 00 00 10 cb 00 00 00 BF 00 00 00 00 00 FF 00 00 00 00 00
                    23 00 00 00 00 00 02 00 b0
                    29 00 00 00 00 00 0d cb 00 00 00 00 00 00 00 00 00 00 77 77
                    23 00 00 00 00 00 02 00 c0
                    29 00 00 00 00 00 10 cb 01 01 01 01 01 01 01 01 01 01 01 01 01 01 01
                    23 00 00 00 00 00 02 00 d0
                    29 00 00 00 00 00 10 cb 01 01 01 F3 01 01 01 01 00 F3 00 00 01 00 01
                    23 00 00 00 00 00 02 00 e0
                    29 00 00 00 00 00 0d cb 00 01 00 01 00 01 00 01 00 00 77 07
                    23 00 00 00 00 00 02 00 f0
                    29 00 00 00 00 00 0C cb FF FF FF FF FF FF 03 33 03 00 70
                    23 00 00 00 00 00 02 00 80
                    29 00 00 00 00 00 0D cc 08 09 18 19 0C 0D 0E 0F 07 07 07 07
                    23 00 00 00 00 00 02 00 90
                    29 00 00 00 00 00 0D cc 09 08 19 18 0F 0E 0D 0C 07 07 07 07
                    23 00 00 00 00 00 02 00 a0
                    29 00 00 00 00 00 0f cc 14 15 16 17 1C 1D 1E 1F 01 04 20 07 07 07
                    23 00 00 00 00 00 02 00 b0
                    29 00 00 00 00 00 0A cc 01 02 03 04 05 06 07 07 00
                    23 00 00 00 00 00 02 00 80
                    29 00 00 00 00 00 10 cd 1A 01 11 12 1A 05 18 07 1A 1A 23 23 23 1F 1E
                    23 00 00 00 00 00 02 00 90
                    29 00 00 00 00 00 04 cd 1D 23 23
                    23 00 00 00 00 00 02 00 a0
                    29 00 00 00 00 00 10 cd 1A 02 11 12 1A 06 18 08 1A 1A 23 23 23 1F 1E
                    23 00 00 00 00 00 02 00 b0
                    29 00 00 00 00 00 04 cd 1D 23 23
                    23 00 00 00 00 00 02 00 80
                    29 00 00 00 00 00 0B A4 AF 00 20 04 00 17 15 03 60 00
                    23 00 00 00 00 00 02 00 90
                    29 00 00 00 00 00 04 A4 00 00 00
                    23 00 00 00 00 00 02 00 80
                    29 00 00 00 00 00 0D A7 FF 0F 1E 00 21 00 01 98 00 00 00 00
                    23 00 00 00 00 00 02 00 90
                    29 00 00 00 00 00 0B A7 1E 21 3E 00 00 BE 90 CE 05 f0
                    23 00 00 00 00 00 02 00 A0
                    23 00 00 00 00 00 02 A7 30
                    23 00 00 00 00 00 02 00 B0
                    29 00 00 00 00 00 06 A7 01 20 1D 00 00
                    23 00 00 00 00 00 02 00 C0
                    29 00 00 00 00 00 0D A7 FF 0F 1E 00 1F 00 01 18 00 00 00 00
                    23 00 00 00 00 00 02 00 D0 
                    29 00 00 00 00 00 0B A7 FF FF 1E 00 01 7C 81 7C 0B E0
                    23 00 00 00 00 00 02 00 E0 
                    23 00 00 00 00 00 02 A7 30
                    23 00 00 00 00 00 02 00 F0
                    29 00 00 00 00 00 06 A7 00 40 3A 00 00
                    23 00 00 00 00 00 02 00 80
                    29 00 00 00 00 00 0D A9 00 00 00 00 00 00 00 00 00 00 00 00
                    23 00 00 00 00 00 02 00 90
                    29 00 00 00 00 00 0B A9 00 00 00 00 00 00 00 00 00 00
                    23 00 00 00 00 00 02 00 A0
                    23 00 00 00 00 00 02 A9 00 
                    23 00 00 00 00 00 02 00 B0
                    29 00 00 00 00 00 06 A9 00 00 00 00 00
                    23 00 00 00 00 00 02 00 C0
                    29 00 00 00 00 00 0F A9 FF 3A 49 00 1E 00 01 00 00 00 00 00 00 77
                    23 00 00 00 00 00 02 00 D0 
                    29 00 00 00 00 00 0B A9 FF FF 1D 00 01 7C 81 7C 0B E0
                    23 00 00 00 00 00 02 00 E0 
                    23 00 00 00 00 00 02 A9 30
                    23 00 00 00 00 00 02 00 F0
                    29 00 00 00 00 00 06 A9 00 3C 3C 00 00
                    23 00 00 00 00 00 02 00 B0
                    29 00 00 00 00 00 09 A4 05 f0 0b e0 00 00 0b e0
                    23 00 00 00 00 00 02 00 80
                    29 00 00 00 00 00 10 AB 05 14 00 00 ff 6a 00 00 00 00 00 00 00 00 00
                    23 00 00 00 00 00 02 00 A0
                    29 00 00 00 00 00 10 AB 00 00 00 00 00 00 00 07 00 00 00 00 01 00 00
                    23 00 00 00 00 00 02 00 B0
                    29 00 00 00 00 00 0D AB 00 00 40 0a 00 00 44 04 00 00 00 00
                    23 00 00 00 00 00 02 00 93
                    23 00 00 00 00 00 02 b3 01
                    23 00 00 00 00 00 02 00 80
                    29 00 00 00 00 00 08 ce 00 00 00 00 00 00 00
                    23 00 00 00 00 00 02 00 87
                    29 00 00 00 00 00 08 ce 00 00 33 00 33 00 00
                    23 00 00 00 00 00 02 00 f0
                    29 00 00 00 00 00 05 ce 00 00 00 00
                    23 00 00 00 00 00 02 00 90
                    29 00 00 00 00 00 10 ce 00 00 00 f0 00 00 00 00 fc 00 fc 00 00 00 00
                    23 00 00 00 00 00 02 00 a0
                    29 00 00 00 00 00 08 ce 00 00 40 40 40 00 00
                    23 00 00 00 00 00 02 00 b0
                    29 00 00 00 00 00 10 ce 01 01 01 01 01 01 01 01 f1 01 f1 01 01 01 01
                    23 00 00 00 00 00 02 00 c0
                    29 00 00 00 00 00 08 ce 01 01 01 01 01 01 01
                    23 00 00 00 00 00 02 00 d0
                    29 00 00 00 00 00 10 ce 04 04 04 04 04 04 04 04 f7 04 f7 04 04 00 00
                    23 00 00 00 00 00 02 00 e0
                    29 00 00 00 00 00 08 ce 00 00 15 15 15 04 04
                    23 00 00 00 00 00 02 00 f4
                    23 00 00 00 00 00 02 ce 25
//                    23 00 00 00 00 00 02 00 00
//                    29 00 00 00 00 00 19 e1 00 06 0c 16 1e 26 32 46 53 66 72 7b 7e 76 6c 5b 47 35 29 22 19 10 0c 00
//                    23 00 00 00 00 00 02 00 00
//                    29 00 00 00 00 00 19 e2 00 06 0c 16 1e 26 32 46 53 66 72 7b 7e 76 6c 5b 47 35 29 22 19 10 0c 00
//                    23 00 00 00 00 00 02 00 00
//                    29 00 00 00 00 00 19 e3 00 06 0c 16 1e 26 32 46 53 66 72 7b 7e 76 6c 5b 47 35 29 22 19 10 0c 00
//                    23 00 00 00 00 00 02 00 00
//                    29 00 00 00 00 00 19 e4 00 06 0c 16 1e 26 32 46 53 66 72 7b 7e 76 6c 5b 47 35 29 22 19 10 0c 00
//                    23 00 00 00 00 00 02 00 00
//                    29 00 00 00 00 00 19 e5 00 06 0c 16 1e 26 32 46 53 66 72 7b 7e 76 6c 5b 47 35 29 22 19 10 0c 00
//                    23 00 00 00 00 00 02 00 00
//                    29 00 00 00 00 00 19 e6 00 06 0c 16 1e 26 32 46 53 66 72 7b 7e 76 6c 5b 47 35 29 22 19 10 0c 00
//                    23 00 00 00 00 00 02 00 00
//                    29 00 00 00 00 00 22 ec 40 44 44 44 44 44 44 44 44 44 44 44 44 44 44 44 44 44 44 44 44 44 44 44 44 44 44 44 44 44 44 44 04
//                    23 00 00 00 00 00 02 00 00
//                    29 00 00 00 00 00 22 ed 40 44 44 44 44 44 44 44 44 44 44 44 44 44 44 44 44 44 44 44 44 44 44 44 44 44 44 44 44 44 44 44 04
//                    23 00 00 00 00 00 02 00 00
//                    29 00 00 00 00 00 22 ee 40 44 44 44 44 44 44 44 44 44 44 44 44 44 44 44 44 44 44 44 44 44 44 44 44 44 44 44 44 44 44 44 04
                    23 00 00 00 00 00 02 00 80
                    29 00 00 00 00 00 0D D8 00 00 00 00 00 00 80 80 00 00 01 02
                    23 00 00 00 00 00 02 00 90
                    29 00 00 00 00 00 0D D8 00 00 00 80 80 80 80 80 00 00 00 00
                    23 00 00 00 00 00 02 00 A0
                    29 00 00 00 00 00 0D D8 01 02 02 03 05 06 07 09 0a 1b 43 6b
                    23 00 00 00 00 00 02 00 B0
                    29 00 00 00 00 00 0D D8 00 00 80 80 81 81 81 81 81 83 8a 91
                    23 00 00 00 00 00 02 00 C0
                    29 00 00 00 00 00 0D D8 81 82 83 85 87 89 8d 90 92 97 9b a0
                    23 00 00 00 00 00 02 00 D0
                    29 00 00 00 00 00 0D D8 02 02 03 04 06 08 0a 0d 10 1e 2c 39
                    23 00 00 00 00 00 02 00 C0
                    29 00 00 00 00 00 05 D7 82 80 C0 FF
                    23 00 00 00 00 00 02 00 00
                    23 00 00 00 00 00 02 84 80
                    29 01 00 00 00 00 03 44 03 02
//                    23 00 00 00 00 00 02 00 00
//                    23 00 00 00 05 00 02 fb 01
//                    23 00 00 00 00 00 02 51 ff
                    23 00 00 00 00 00 02 53 00
                    23 00 00 00 00 00 02 55 03
                    23 00 00 00 00 00 02 00 80
                    29 01 00 00 00 00 03 ff 00 00
                    23 00 00 00 00 00 02 00 00
                    29 00 00 00 00 00 04 ff 00 00 00
                    29 00 00 00 00 00 03 99 95 27
                    15 00 00 00 00 00 02 35 00
					05 01 00 00 78 00 01 11
					05 01 00 00 14 00 01 29
                    29 00 00 00 00 00 03 99 00 00];
		qcom,mdss-dsi-off-command = [29 00 00 00 00 00 03 99 95 27
                    05 01 00 00 32 00 02 28 00
					05 01 00 00 78 00 02 10 00];
		qcom,mdss-dsi-on-command-state = "dsi_lp_mode";
		qcom,mdss-dsi-off-command-state = "dsi_hs_mode";
		qcom,mdss-dsi-h-sync-pulse = <1>;
		qcom,mdss-dsi-traffic-mode = "burst_mode";
		qcom,mdss-dsi-lane-map = "lane_map_0123";
		qcom,mdss-dsi-bllp-eof-power-mode;
		qcom,mdss-dsi-bllp-power-mode;
		qcom,mdss-dsi-lane-0-state;
		qcom,mdss-dsi-lane-1-state;
		qcom,mdss-dsi-lane-2-state;
		qcom,mdss-dsi-lane-3-state;
		qcom,mdss-dsi-te-pin-select = <1>;
		qcom,mdss-dsi-te-v-sync-rd-ptr-irq-line = <0x2c>;
		qcom,mdss-dsi-te-dcs-command = <1>;
		qcom,mdss-dsi-te-check-enable;
		qcom,mdss-dsi-te-using-te-pin;
        qcom,esd-check-enabled;
		qcom,mdss-dsi-panel-status-command = [06 01 00 01 05 00 02 0E 08];
		qcom,mdss-dsi-panel-status-command2 = [06 01 00 01 05 00 02 1d 08];
		qcom,mdss-dsi-panel-status-command-state = "dsi_hs_mode";
		qcom,mdss-dsi-panel-status-check-mode = "reg_read";
		qcom,mdss-dsi-panel-status-read-length = <1>;
		qcom,mdss-dsi-panel-max-error-count = <3>;
        qcom,mdss-dsi-panel-status-value = <0x80>;
        qcom,mdss-dsi-panel-status-value2 = <0x00>;
//		qcom,mdss-mdp-transfer-time-us = <12000>;
//      qcom,mdss-dsi-panel-clockrate = <950000000>;
        /*qcom,mdss-tear-check-sync-cfg-height = <0xff0>;*/
        /*qcom,mdss-tear-check-sync-init-val = <1920>;*/
        /*qcom,mdss-tear-check-sync-threshold-start = <4>;*/
        /*qcom,mdss-tear-check-sync-threshold-continue = <4>;*/
        /*qcom,mdss-tear-check-start-pos = <0>;*/
        /*qcom,mdss-tear-check-rd-ptr-trigger-intr = <19201>;*/
        /*qcom,mdss-tear-check-frame-rate = <5500>;*/

		qcom,mdss-dsi-panel-timings = [d2 30 20 00 5e 62 26 34 26 03 04 00];
		qcom,mdss-dsi-t-clk-post = <0x03>;
		qcom,mdss-dsi-t-clk-pre = <0x27>;
		qcom,mdss-dsi-bl-min-level = <1>;
		qcom,mdss-dsi-bl-max-level = <255>;
		qcom,mdss-dsi-dma-trigger = "trigger_sw";
		qcom,mdss-dsi-mdp-trigger = "none";
		qcom,mdss-dsi-bl-pmic-control-type = "bl_ctrl_dcs";
		qcom,mdss-dsi-reset-sequence = <1 3>, <0 6>, <1 3>;
        qcom,mdss-dsi-lp11-init;
        qcom,mdss-dsi-hfp-power-mode;
        qcom,mdss-dsi-hbp-power-mode;
        qcom,mdss-dsi-hsa-power-mode;
//	    qcom,ulps-enabled;
//        qcom,mdss-dsi-init-delay-us = <50000>;
		qcom,mdss-pan-physical-width-dimension = <61>;
		qcom,mdss-pan-physical-height-dimension = <110>;
	};
};
