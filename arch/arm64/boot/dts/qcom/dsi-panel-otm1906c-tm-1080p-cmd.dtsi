/* Copyright (c) 2013, The Linux Foundation. All rights reserved.
 *
 * This program is free software; you can redistribute it and/or modify
 * it under the terms of the GNU General Public License version 2 and
 * only version 2 as published by the Free Software Foundation.
 *
 * This program is distributed in the hope that it will be useful,
 * but WITHOUT ANY WARRANTY; without even the implied warranty of
 * MERCHANTABILITY or FITNESS FOR A PARTICULAR PURPOSE.  See the
 * GNU General Public License for more details.
 */

/*---------------------------------------------------------------------------
 * This file is autogenerated file using gcdb parser. Please do not edit it.
 * Update input XML file to add a new entry or update variable in this file
 * VERSION = "1.0"
 *---------------------------------------------------------------------------*/
&mdss_mdp {
	dsi_otm1906c_tm_1080p_cmd: qcom,mdss_dsi_otm1906c_tm_1080p_cmd {
		qcom,mdss-dsi-panel-name = "otm1906c tm 1080p command mode dsi panel";
		qcom,mdss-dsi-panel-controller = <&mdss_dsi0>;
		qcom,mdss-dsi-panel-type = "dsi_cmd_mode";
		qcom,mdss-dsi-panel-destination = "display_1";
		qcom,mdss-dsi-panel-framerate = <60>;
		qcom,mdss-dsi-virtual-channel-id = <0>;
		qcom,mdss-dsi-stream = <0>;
		qcom,mdss-dsi-panel-width = <1080>;
		qcom,mdss-dsi-panel-height = <1920>;
		qcom,mdss-dsi-h-front-porch = <90>;
		qcom,mdss-dsi-h-back-porch = <90>;
		qcom,mdss-dsi-h-pulse-width = <1>;
		qcom,mdss-dsi-h-sync-skew = <0>;
		qcom,mdss-dsi-v-back-porch = <18>;
		qcom,mdss-dsi-v-front-porch = <20>;
		qcom,mdss-dsi-v-pulse-width = <2>;
		qcom,mdss-dsi-h-left-border = <0>;
		qcom,mdss-dsi-h-right-border = <0>;
		qcom,mdss-dsi-v-top-border = <0>;
		qcom,mdss-dsi-v-bottom-border = <0>;
		qcom,mdss-dsi-bpp = <24>;
		qcom,mdss-dsi-color-order = "rgb_swap_rgb";
		qcom,mdss-dsi-underflow-color = <0xff>;
		qcom,mdss-dsi-border-color = <0>;
//		qcom,mdss-dsi-pixel-packing = "tight";
		qcom,mdss-dsi-pixel-alignment = <0>;
		qcom,mdss-dsi-on-command = [23 00 00 00 00 00 02 00 00
                    29 00 00 00 00 00 04 FF 19 06 01
                    23 00 00 00 00 00 02 00 80
                    29 00 00 00 00 00 03 FF 19 06
                    23 00 00 00 00 00 02 00 A0
                    23 00 00 00 00 00 02 A7 3A
                    23 00 00 00 00 00 02 00 00
                    29 00 00 00 05 00 04 ff 00 00 00
                    23 00 00 00 00 00 02 55 03
                    23 00 00 00 00 00 02 53 2c
                    15 00 00 00 00 00 02 35 00
					05 01 00 00 78 00 01 11
                    05 01 00 00 14 00 01 29];
		qcom,mdss-dsi-off-command = [29 00 00 00 00 00 03 99 95 27
                    05 01 00 00 32 00 02 28 00
					05 01 00 00 78 00 02 10 00];
		qcom,mdss-dsi-on-command-state = "dsi_lp_mode";
		qcom,mdss-dsi-off-command-state = "dsi_hs_mode";
		qcom,mdss-dsi-h-sync-pulse = <1>;
		qcom,mdss-dsi-traffic-mode = "burst_mode";
		qcom,mdss-dsi-lane-map = "lane_map_0123";
		qcom,mdss-dsi-bllp-eof-power-mode;
		qcom,mdss-dsi-bllp-power-mode;
		qcom,mdss-dsi-lane-0-state;
		qcom,mdss-dsi-lane-1-state;
		qcom,mdss-dsi-lane-2-state;
		qcom,mdss-dsi-lane-3-state;
		qcom,mdss-dsi-te-pin-select = <1>;
		qcom,mdss-dsi-te-v-sync-rd-ptr-irq-line = <0x2c>;
		qcom,mdss-dsi-te-dcs-command = <1>;
		qcom,mdss-dsi-te-check-enable;
		qcom,mdss-dsi-te-using-te-pin;
//        qcom,esd-check-enabled;
		qcom,mdss-dsi-panel-status-command = [06 01 00 01 05 00 02 0E 08];
		qcom,mdss-dsi-panel-status-command2 = [06 01 00 01 05 00 02 1d 08];
		qcom,mdss-dsi-panel-status-command-state = "dsi_hs_mode";
		qcom,mdss-dsi-panel-status-check-mode = "reg_read";
		qcom,mdss-dsi-panel-status-read-length = <1>;
		qcom,mdss-dsi-panel-max-error-count = <3>;
        qcom,mdss-dsi-panel-status-value = <0x80>;
        qcom,mdss-dsi-panel-status-value2 = <0x00>;
//		qcom,mdss-mdp-transfer-time-us = <12000>;
//      qcom,mdss-dsi-panel-clockrate = <950000000>;
        /*qcom,mdss-tear-check-sync-cfg-height = <0xff0>;*/
        /*qcom,mdss-tear-check-sync-init-val = <1920>;*/
        /*qcom,mdss-tear-check-sync-threshold-start = <4>;*/
        /*qcom,mdss-tear-check-sync-threshold-continue = <4>;*/
        /*qcom,mdss-tear-check-start-pos = <0>;*/
        /*qcom,mdss-tear-check-rd-ptr-trigger-intr = <19201>;*/
        /*qcom,mdss-tear-check-frame-rate = <5500>;*/


		qcom,mdss-dsi-panel-timings = [d2 30 20 00 5e 62 26 34 26 03 04 00];
		qcom,mdss-dsi-t-clk-post = <0x03>;
		qcom,mdss-dsi-t-clk-pre = <0x27>;
		qcom,mdss-dsi-bl-min-level = <1>;
		qcom,mdss-dsi-bl-max-level = <255>;
		qcom,mdss-dsi-dma-trigger = "trigger_sw";
		qcom,mdss-dsi-mdp-trigger = "none";
		qcom,mdss-dsi-bl-pmic-control-type = "bl_ctrl_dcs";
		qcom,mdss-dsi-reset-sequence = <1 3>, <0 6>, <1 3>;
        qcom,mdss-dsi-lp11-init;
//        qcom,mdss-dsi-hfp-power-mode;
//        qcom,mdss-dsi-hbp-power-mode;
//        qcom,mdss-dsi-hsa-power-mode;
//	    qcom,ulps-enabled;
//        qcom,mdss-dsi-init-delay-us = <50000>;
		qcom,mdss-pan-physical-width-dimension = <61>;
		qcom,mdss-pan-physical-height-dimension = <110>;
	};
};
