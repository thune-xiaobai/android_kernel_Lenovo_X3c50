
qcom,2086226_lenovo_bl258_atl_3600mah_averaged_masterslave_july20th2015 {
	/* #2086226_Lenovo_BL258_ATL_3600mAh_averaged_MasterSlave_July20th2015*/
	qcom,max-voltage-uv = <4400000>;
	qcom,nom-batt-capacity-mah = <3600>;
	qcom,batt-id-kohm = <5>;
	qcom,battery-beta = <3435>;
	qcom,battery-type = "2086226_lenovo_bl258_atl_3600mah_averaged_masterslave_july20th2015";
	qcom,chg-rslow-comp-c1 = <3135031>;
	qcom,chg-rslow-comp-c2 = <4098980>;
	qcom,chg-rs-to-rslow = <864037>;
	qcom,chg-rslow-comp-thr = <0x9D>;
	qcom,checksum = <0x6DA2>;
	qcom,gui-version = "PMI8994GUI - 2.1.6.7";
	qcom,fg-profile-data = [
		 DF 83 BD 7C 
		 0C 81 2C 77 
		 6B 83 EC 75 
		 4C 8A 15 95 
		 10 82 3D 9A 
		 F1 BC 3A C9 
		 52 12 ED 83 
		 C5 7C F7 80 
		 E5 76 5D 83 
		 D1 4B 79 82 
		 89 8E 4B 82 
		 DF 99 44 BD 
		 69 CA 54 0E 
		 5B 0E 0B 5A 
		 14 70 28 FE 
		 74 3C F4 3C 
		 5E 2C 00 00 
		 6B 3E 9D 2B 
		 CE 44 00 00 
		 00 00 00 00 
		 00 00 00 00 
		 BA 6A 3F 69 
		 74 6B 9E 82 
		 DF 6F 82 61 
		 61 60 E5 7B 
		 29 6F E7 60 
		 BF 7D 01 99 
		 1D B5 61 1F 
		 5F A0 71 0C 
		 28 00 FF 36 
		 F0 11 30 03 
		 00 00 00 0C 
	];
};
